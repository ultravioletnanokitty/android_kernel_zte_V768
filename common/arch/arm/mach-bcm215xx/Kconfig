## modules/drivers/char/brcm/hal_cam/Kconfig
```kconfig
config BRCM_HAL_CAM
	bool "Broadcom Camera HAL Driver"
	depends on I2C
	depends on BRCM_MODULES && BRCM_MODULES_PRIV
	default Y
	---help---
	  Broadcom Camera HAL Driver


config BRCM_HAL_CAM_WITH_STILL_YUV
	bool "Broadcom Camera HAL Driver for still YUV sensor "
	depends on I2C
	depends on BRCM_MODULES && BRCM_MODULES_PRIV
	default Y
	---help---
	  Broadcom Camera HAL Driver for still YUV sensor

config BCM_CAM_OV5640
	bool "Camera OV5640"
	depends on BRCM_HAL_CAM
	default N
	---help---
	Camera driver for OV5640

config BCM_CAM_MT9T111
	bool "Camera MT9T111"
	depends on BRCM_HAL_CAM
	default N
	---help---
	Camera driver for MT9T111

config BCM_CAM_TCM9001MD
	bool "Camera TCM9001MD"
	depends on BRCM_HAL_CAM
	default N
	---help---
	Camera driver for TCM9001MD

config BCM_CAM_OV7692
	bool "Camera OV7692"
	depends on BRCM_HAL_CAM
	default Y 
	---help---
	Camera driver for OV7692

config BCM_CAM_HI253
	bool "Camera HI253"
	depends on BRCM_HAL_CAM
	default Y 
	---help---
	Camera driver for HI253

config BCM_CAM_MT9D115
	bool "Camera MT9D115"
	depends on BRCM_HAL_CAM
	default N
	---help---
	Camera driver for MT9D115
	
config BCM_CAM_OV7690
	bool "Camera OV7690"
	depends on BRCM_HAL_CAM
	default N
	---help---
	Camera driver for OV7690
	
config BCM_CAM_S5K5CA
	bool "Camera S5K5CA "
	depends on BRCM_HAL_CAM
	default N
	---help---
	Camera driver for S5K5CA
	
#xiongbiao@wind-mobi.com 20120307 start
#add xia lang camera on L400_xal 
config BCM_CAM_S5K5CA_XIA_LANG
	bool "Camera S5K5CA xia lang"
	depends on BCM_CAM_S5K5CA
	default N
	---help---
	Camera driver for S5K5CA xia lang
#xiongbiao@wind-mobi.com 20120307 end
			
config BCM_CAM_STV0986
	bool "Camera STV0986"
	depends on BRCM_HAL_CAM
	depends on BOARD_EXPLORER || ARCH_BCM2153
	default N
	---help---
	Camera driver for STV0986

config BCM_CAM_STV0987
        bool "Camera STV0987"
        depends on BRCM_HAL_CAM
        depends on ARCH_BCM21553_B0 || ARCH_BCM21553_B1
        default N
        ---help---
        Camera driver for STV0987

config CAM_CSI2
	bool "CSI2 interface for STV0987"
	depends on BCM_CAM_MT9D115
	default N
        ---help---
        Camera host interface CSI2 

config CAM_CPI
	bool "Camera Host Interface CPI"
	depends on (!CAM_CSI2)
	default N
        ---help---
        Camera Host Interface CPI

config BCM_CAM_OV2655
	bool "Camera OV2655"
	depends on BRCM_HAL_CAM_WITH_STILL_YUV
	default N
	---help---
	Camera driver for OV2655
```
