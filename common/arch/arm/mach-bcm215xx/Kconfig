## common/arch/arm/mach-bcm215xx/Kconfig
```kconfig
menu "Broadcom BCM215XX Implementations"
	depends on ARCH_BCM215XX

comment "BCM215XX Core Type"

choice
	prompt "Silicon version selection in BCM21553 family of devices"
	depends on ARCH_BCM215XX
	default ARCH_BCM21553_A0

config ARCH_BCM21553_A0
	bool "BCM21553 A0 based system"

config ARCH_BCM21553_B0
	select ARCH_HAS_CPUFREQ
	bool "BCM21553 B0 based system"

config BCM21553_B0_V3D_HACK
	depends on ARCH_BCM21553_B0 && BRCM_V3D
	bool "Enable V3D Hack to avoid the APB slave registers getting stuck"

config ARCH_BCM21553_B1
	select ARCH_HAS_CPUFREQ
	bool "BCM21553 B1 based system"

endchoice

comment "BCM21553 Board Type"

choice
       prompt "Board selection in BCM21553 family of devices"
       depends on ARCH_BCM21553_A0 || ARCH_BCM21553_B0 || ARCH_BCM21553_B1
       default BOARD_ATHENARAY

config BOARD_ATHENARAY
	bool "Broadcom BCM21553 AthenaRay EDN10 development board"
	help
	  Configure this option to specify the whether the board used
	  for development is a BCM21553 EDN10 AthenaRay.

config BOARD_ATHENARAY_B1
	bool "Broadcom BCM21553 AthenaRay B1 development board"
	help
	  Configure this option to specify the whether the board used
	  for development is a BCM21553 B1 AthenaRay.

config BOARD_ATHENARAY_EDN20
	bool "Broadcom BCM21553 AthenaRay EDN20 development board"
	help
	  Configure this option to specify the whether the board used
	  for development is a BCM21553 EDN20 AthenaRay.

config BOARD_THUNDERBIRD
	bool "Broadcom BCM21553 Thunderbird board"
	help
	  Configure this option to specify the whether the used
	  for development is a BCM21553 Thunderbird.

config BOARD_THUNDERBIRD_EDN31
	bool "Broadcom BCM21553 Thunderbird EDN31 board"
	help
	  Configure this option to specify the whether the used
	  for development is a BCM21553 Thunderbird EDN31.

config BOARD_THUNDERBIRD_EDN5x
	bool "Broadcom BCM21553 Thunderbird EDN5x boards"
	help
	  Configure this option to specify whether the board used
	  for development is a BCM21553 Thunderbird EDN5x.
	  
config BOARD_ACAR
	bool "China reference platform AthenaPebble (ACAR)"
	help
	  Configure this option to specify the whether the used
	  for development is a BCM21553 ACAR board.
	  
config BOARD_ACAR_TYPE_EDN10
	bool "China reference platform AthenaPebble (ACAR) board type EDN10"
	depends on BOARD_ACAR
	help
	  Configure this option to specify the whether the used
	  for development is a BCM21553 ACAR board EDN10.

config BOARD_PASCAL	
    bool "China reference platform AthenaPebble (PASCAL)"
	help
	  Configure this option to specify the whether the used
	  for development is a BCM21553 PASCAL board.

config BOARD_PASCAL_TYPE_EDN10
	bool "China reference platform AthenaPebble (PASCAL) board type EDN10"
	depends on BOARD_PASCAL
	help
	  Configure this option to specify the whether the used
	  for development is a BCM21553 PASCAL board EDN10.

config BOARD_L400
    bool "China reference platform AthenaPebble (L400)"
	help
	  Configure this option to specify the whether the used
	  for development is a BCM21553 L400 board.

config BOARD_L400_TYPE_EDN10
	bool "China reference platform AthenaPebble (PASCAL) board type EDN10"
	depends on BOARD_L400
	help
	  Configure this option to specify the whether the used
	  for development is a BCM21553 PASCAL board EDN10.

config BOARD_TOTORO
	bool "Samsung BCM2155x Totoro board"
	help
	  Configure this option to specify the whether the used
	  for development is a BCM21553 Totoro board.

config BOARD_TASSVE
	bool "Samsung BCM2155x TassVE board"
	help
	  Configure this option to specify the whether the used
	  for development is a BCM21553 TassVE board.

config BOARD_LUISA
	bool "Samsung BCM2155x LUISA board"
	help
	  Configure this option to specify the whether the used
	  for development is a BCM21553 Luisa board.
endchoice

config SDRAM_BASE_ADDR
hex "SDRAM Base address"
depends on ARCH_BCM215XX

config MM_MEMPOOL_BASE_ADDR
hex "Base address for multimedia memory"
default 0
depends on GE_WRAP
depends on ARCH_BCM215XX

config BCM21553_L2_EVCT
        default y
        depends on ARCH_BCM215XX && CACHE_L2X0
        bool "Enable L2 eviction workaround"

config BCM215XX_PM
        bool "Enable Platform power management for BCM215XX platform"
        depends on PM && ARCH_BCM215XX
        help
          Say Yes here to enable platform power management for BCM215XX platform

config ARM1136JFS_CP15_DEBUG
	bool "Enable code to debug ARM1136JF-S CP15 state save-restore"
	depends on CPU_V6
	help
	  Say Yes here to enable code to debug the CP15 register save-restore
	  during the dormant mode entry-exit sequence.

config CPU_FREQ_GOV_BCM21553
	tristate "'BCM21553' governor for BCM21553 frequency scaling"
	depends on CPU_FREQ
	help
	  Enable this cpufreq governor for BCM21553 chipset.

	  To compile this driver as a module, choose M here: the
	  module will be called cpufreq_bcm21553.

config BCM21553_CPU_IDLE_DRV
	bool "Enable CPUIDLE driver for BCM21553"
	depends on PM && ARCH_BCM215XX && CPU_IDLE
	help
	  Say Yes here to enable the cpu idle driver for BCM21553. This driver
	  enables the CPU to be moved to dormant state during system idle to
	  enable more power savings.

config BCM21553_V3D_SYNC_ENABLE
	depends on BRCM_V3D
    bool "Enable synchronization for V3D"
    default N

config BCM21553_1GHZ
	bool "Enable support for 1GHz BCM21553 part"
	depends on ARCH_BCM215XX
	default N

config CDEBUGGER
	depends on ARCH_BCM215XX
	bool "Enable Ramdump dump Feature on 215XX "
	default n

#songjinguo@wind-mobi.com 20120412 start
#add xialang battery for L400_xal
config XIALANG_BATTERY
        bool "config xialang battery"
        depends on ARCH_BCM215XX
        default N
        ---help---
        enable this config if use xialang battery;
#songjinguo@wind-mobi.com 20120412 end

#heweimao@wind-mobi.com 20120612 start
#remove santok led for L400_stk
config REMOVE_SANTOK_LED
        bool "config santok led"
        depends on ARCH_BCM215XX
        default N
        ---help---
        enable this config if use remove santok led;
#songjinguo@wind-mobi.com 20120412 end

endmenu
```

## common/drivers/net/wireless/bcmdhd_4330/Kconfig
```kconfig
config BCMDHD_4330_DRIVER
	bool "BCMDHD_4330_DRIVER"

config BROADCOM_WIFI_RESERVED_MEM
	bool "Enable Wifi Static MEM"

#	depends on MMC
	---help---
	  This module adds support for wireless adapters based on
	  BCM4330 chipset for the Android Gingerbread.
	  If you choose to build a module, it'll be called bcm4330. Say M if
	  unsure.
```

## common/drivers/staging/iio/light/Kconfig
```kconfig
#
# Light sensors
#
comment "Light sensors"

config SENSORS_TSL2563
	tristate "TAOS TSL256[0-3] ambient light sensor"
	depends on I2C
	help
	 If you say yes here you get support for the Taos TSL2560,
	 TSL2561, TSL2562 and TSL2563 ambient light sensors.
	 This driver can also be built as a module.  If so, the module
	 will be called tsl2563.

config TMD2771X
	tristate "tmd2771x light&poximity sensor"
	depends on I2C
	default y
	help
	 this option enable tmd2771x sensor
```

## common/drivers/video/broadcom/Kconfig
```kconfig
config FB_BCM_116X
        tristate "BCM 116X platform framebuffer support"
        depends on FB_BCM && ARCH_BCM116X
        default n

config FB_BCM_215XX
        tristate "BCM 215XX platform framebuffer support"
        depends on FB_BCM && ARCH_BCM215XX
        default n
#
#	Display Controller Drivers
#	- Legacy DPIx/DBIx Interface controller
#	- MIPI DSI controller
#
choice
	prompt "Display Controller"
	depends on FB_BCM_215XX
	help
	   Platform has multiple display controllers supported. System
	   should use one such controller to interface with the display device.
#
#	Controllers.
#
config LCD_CONTROLLER_LEGACY
	boolean "Legacy Z80/M68/DBIx Display Controller"
	select BCM215XX_DSS
	help
	   Legacy display interface controller that supports Z80/M68/DBIx.

config LCD_CONTROLLER_DSI
	boolean "MIPI DSI Controller"
	select BCM215XX_DSS
	help
	   MIPI DSI controller

endchoice

        
config FB_BRCM_DSI
		tristate "Broadcom Platform DSI Framebuffer support"
    	default n
		help
	 	 This framebuffer device driver is for the Broadcom dsi interface.

source "drivers/video/broadcom/bmem_wrapper/Kconfig"
source "drivers/video/broadcom/dss/Kconfig"
source "drivers/video/broadcom/displays/Kconfig"
source "drivers/video/broadcom/hantro/memalloc_wrapper/Kconfig"
source "drivers/video/broadcom/ge/gememalloc_wrapper/Kconfig"
```

## common/drivers/video/broadcom/displays/Kconfig
```kconfig
menu "Broadcom Display Device Drivers"

config PANEL_MAGNA_D51E5TA7601
        tristate "Magna TrulyHVGA LCD Panel with D51E5TA7601 controller"
        default N
        help
          Magna TrulyHVGA LCD Panel with D51E5TA7601 controller

config LCD_DRV_ALL
        tristate "LCD Panel- Compatible all lcd driver ic."
        default N
        help
          Compatible all lcd driver ic.
          
#xiongbiao@wind-mobi.com 2012.02.09 begin
#support mipi lcd compatible on L301          
config LCD_DSI_DRV_ALL
        tristate "mipi LCD Panel- Compatible all dsi lcd driver ic."
        default N
        help
          Compatible all dsi lcd driver ic.
#xiongbiao@wind-mobi.com 2012.02.09 end  

#xiongbiao@wind-mobi.com 2012.02.20 begin
#support mipi lcd compatible on L301          
config LCD_L400_DSI_DRV_ALL
        tristate "mipi LCD Panel- Compatible all dsi lcd driver ic on L400."
        default N
        help
          Compatible all dsi lcd driver ic.
#xiongbiao@wind-mobi.com 2012.02.20 end  
      
config BCM_LCD_NT35582
        tristate "LCD Panel- N35582 controller"
        default N
        help
	  WVGA LCD panel (N35582 controller)

config BCM_LCD_S6D04H0A01
        tristate "LCD Panel- S6D04H0A01 controller"
        default N
        help
	  QVGA LCD panel (S6D04H0A01 controller)

config BCM_LCD_S6D04H0A01_TASSVE
        tristate "LCD Panel- S6D04H0A01 controller"
        default N
        help
	  QVGA LCD panel (S6D04H0A01 controller)	  

config BCM_LCD_ILI9341_BOE
        tristate "LCD Panel- S6D04H0A01 controller"
        default Y
        help
         QVGA LCD panel (BOE controller)

config BCM_LCD_ILI9341_BOE_REV05
        tristate "LCD Panel- S6D04H0A01 controller"
        default Y
        help
         QVGA LCD panel (BOE controller)

config BCM_LCD_S6D04K1
        tristate "LCD Panel- S6D04K1 controller"
        default N
        help
	  QVGA LCD panel (S6D04H0A01 controller)
	  
config BCM_LCD_R61581
        tristate "LCD Controller- R61581 controller"
        default N
        help
	  HVGA LCD panel (Renesas R61581 controller)
config BCM_LCD_R61581B0
        tristate "LCD Controller- R61581B0 controller"
        default N
        help
	  HVGA LCD panel (Renesas R61581B0 controller)
	  
config BCM_LCD_ILI9481
        tristate "LCD Controller- ILI9481 controller"
        default N
        help
	  HVGA LCD panel (ILI9481 controller)
config BCM_LCD_ILI9486L
        tristate "LCD Controller- ILI9486L controller"
        default N
        help
	  HVGA LCD panel (ILI9486L controller)
#shaojiang@wind-mobi.com patch CSP496192 for lcd driver begin
config BCM_LCD_HX8357C_GZ3513
        tristate "LCD Controller- HX8357 controller"
        default N
        help
	  HVGA DSI LCD panel (HX8357/GZ3513 controller)
#shaojiang@wind-mobi.com patch CSP496192 for lcd driver end
	  
# xiongbiao@wind-mobi.com 2011.10.31 begin
# Add HX8357B LCD support.
config BCM_LCD_HX8357B
        tristate "LCD Controller- HX8357B controller"
        default N
        help
	  HVGA LCD panel (HX8357B controller)
# xiongbiao@wind-mobi.com 2011.10.31 end

# xiongbiao@wind-mobi.com 2011.12.02 begin
# Add HX8357C LCD support.
config BCM_LCD_HX8357C
        tristate "LCD Controller- HX8357C controller"
        default N
        help
	  HVGA LCD panel (HX8357C controller)
# xiongbiao@wind-mobi.com 2011.12.02 end

# liubing@wind-mobi.com 2011.02.07 begin
# Add HX8363B LCD support.
config BCM_LCD_HX8363B_YT40F26B0
        tristate "LCD Controller- HX8363B controller"
        default N
        help
	  WVGA LCD panel (HX8363B controller)
# liubing@wind-mobi.com 2012.02.07 end

# xiongbiao@wind-mobi.com 2011.02.15 begin
# Add HX8369A_YT40F25J0 LCD support.
config BCM_LCD_HX8369A_YT40F25J0
        tristate "LCD Controller- HX8369A controller"
        default N
        help
	  WVGA LCD panel (HX8369A controller)
# xiongbiao@wind-mobi.com 2011.02.15 end

config BCM_LCD_S6D04K1_LUISA_HW02
        tristate "LCD Panel- S6D04K1 controller"
        default N
        help
	  QVGA LCD panel (S6D04H0A01 controller)

if BCM_LCD_NT35582 || BCM_LCD_R61581 || BCM_LCD_R61581B0
menu "Custom display resolution"
config ENABLE_HVGA
    bool "Enable HVGA display"
    depends on BCM_LCD_NT35582
    default y
    ---help---
    Select this to enable HVGA display

config ENABLE_QVGA
    bool "Enable QVGA display"
    depends on (BCM_LCD_NT35582 || BCM_LCD_R61581 || BCM_LCD_R61581B0) && !ENABLE_HVGA
    default n
    ---help---
    Select this to enable QVGA display
endmenu
endif

config BCM_LCD_BTG222432
        tristate "HYUNDAI BTG222432 LCD support"
        depends on MACH_MARTINI || BOARD_BONDRAY || BOARD_EXPLORER
        ---help---
         Support for HYUNDAI BTG222432 LCD
         Say Y here to enable HYUNDAI BTG222432 LCD driver
         Say m to make it a loadable module

config BCM_LCD_HX8352_DF2440V8
    tristate "Wintek HX8352 DF2440V8 LCD support"
    depends on BOARD_BRAVA || BOARD_BRAVA_EDN10
    ---help---
     Support for WINTEK HX8352 DF2440V8 LCD Driver
     Say Y here to enable Wintek HX8352 DF2440V8 LCD driver
     Say m to make it a loadable module

config BCM_LCD_HX8347_TFT1P5158
    tristate "Truely HX8347 TFT1P5158 LCD support"
     default n
    ---help---
     Support for Truely HX8347 TFT1P5158 LCD Driver
     Say Y here to enable Truely HX8347 TFT1P5158 LCD driver
     Say m to make it a loadable module

config BCM_LCD_SKIP_INIT
    bool "Skip LCD controller and panel initialization"
     default n
    ---help---
     Support for skipping LCD controller and panel initialization.
     Say Y here if bootloader does the job of initialization

config ARGB8888
    bool "Enable 24bit colour mode"
#    depends on BCM_LCD_NT35582 || BCM_LCD_R61581 ||BCM_LCD_HX8357C_GZ3513||BCM_LCD_HX8363B_YT40F26B0||BCM_LCD_HX8369A_T43KPS06||BCM_LCD_HX8369A_TFT480800
    depends on LCD_DSI_DRV_ALL || LCD_L400_DSI_DRV_ALL
    default n
    ---help---
    Say Y to enable 24bit colour mode

endmenu
```

## common/drivers/video/broadcom/dss/Kconfig
```kconfig
menuconfig BCM_DSS
        bool "Broadcom Display Subsystem support (EXPERIMENTAL)"
	default N
        help
          Broadcom Display Subsystem support.

if BCM_DSS

config BCM215XX_DSS
        bool "BCM215XX Display Subsystem support (EXPERIMENTAL)"
        depends on ARCH_BCM215XX
	default y
        help
          BCM215XX Display Subsystem support.

endif
```

## modules/drivers/char/brcm/fuse_ril/Kconfig
```kconfig
config BRCM_FUSE_RIL_CIB
	#tristate "Broadcom FUSE RIL drivers CIB"
	boolean "Broadcom FUSE RIL drivers CIB"
	depends on BRCM_MODULES && BRCM_MODULES_PRIV
	default N
	---help---
	  Broadcom FUSE RIL drivers CIB

config BRCM_SIM_SECURE_ENABLE
	boolean "Broadcom SIM Secure Enable"
	depends on BRCM_MODULES && BRCM_MODULES_PRIV
	default N
	---help---
	  Broadcom SIM Secure Enable

config BRCM_RADIO_POWER_ONOFF_CARD
	boolean "Broadcom Radio Power onoff card"
	depends on BRCM_MODULES && BRCM_MODULES_PRIV
	default N
	---help---
	  Broadcom Radio Power onoff card
```
